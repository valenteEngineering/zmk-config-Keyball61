/*
 * Placeholder password macro.
 *
 * To use a real password locally:
 *   cp config/secrets.example.dtsi config/secrets.dtsi
 *   edit config/secrets.dtsi and replace the bindings line with the real password.
 *
 * config/secrets.dtsi is gitignored, so the real password is never committed.
 * CI and fresh clones fall through to this file via __has_include in the keymap.
 */
pw_main: pw_main {
    compatible = "zmk,behavior-macro";
    #binding-cells = <0>;
    wait-ms = <5>;
    tap-ms = <5>;
    bindings = <&macro_tap &kp P &kp W>;
};
